## Kconfig
```kconfig
menu "LVGL ESP Drivers"
    config SPI_HOST_MAX
        int
        prompt "Maximum number of SPI ports"

        default 2
    config LV_LVGL_H_INCLUDE_SIMPLE
        bool
        prompt "LVGL declaration without being a subfolder"

        default y
  
    rsource "lvgl_tft/Kconfig"

    rsource "lvgl_touch/Kconfig"

endmenu

menu "I2C Port Settings"
    depends on LV_I2C && !HAVE_I2C_MANAGER

    rsource "lvgl_i2c/Kconfig"

endmenu
```
